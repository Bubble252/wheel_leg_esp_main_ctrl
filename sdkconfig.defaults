## sdkconfig.defaults
```kconfig
# WiFi 遥控器 WebSocket 支持
CONFIG_HTTPD_WS_SUPPORT=y

# CPU 主频 240MHz
CONFIG_ESP_DEFAULT_CPU_FREQ_MHZ_240=y
CONFIG_ESP_DEFAULT_CPU_FREQ_MHZ=240

# Brownout 检测灵敏度降低 (USB供电+WiFi容易触发欠压重启)
# Level 7=3.10V(太灵敏), Level 4=2.84V(适合USB供电)
CONFIG_ESP_BROWNOUT_DET_LVL_SEL_4=y
CONFIG_ESP_BROWNOUT_DET_LVL=4

# FreeRTOS 高精度定时 (平衡控制需要)
CONFIG_FREERTOS_HZ=1000
```
